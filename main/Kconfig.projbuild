## main/Kconfig.projbuild
```kconfig
menu "Example Configuration"

    config ESP_WIFI_SSID
        string "WiFi SSID"
        default "myssid"
        help
            SSID (network name) for the example to connect to.

    config ESP_WIFI_PASSWORD
        string "WiFi Password"
        default "mypassword"
        help
            WiFi password (WPA or WPA2) for the example to connect to.

    config DEVICE_HOSTNAME
        string "Device Hostname"
        default "esp32p4-audio"
        help
             Hostname to register on the network.

endmenu
```
